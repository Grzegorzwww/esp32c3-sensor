## sdkconfig.defaults
```kconfig
# ESP32-C6 Configuration

# Component config
CONFIG_FREERTOS_HZ=1000

# Serial flasher config
CONFIG_ESPTOOLPY_FLASHMODE_QIO=y
CONFIG_ESPTOOLPY_FLASHFREQ_80M=y
CONFIG_ESPTOOLPY_FLASHSIZE_4MB=y

# Compiler options
CONFIG_COMPILER_OPTIMIZATION_SIZE=y

# Log output
CONFIG_LOG_DEFAULT_LEVEL_INFO=y
CONFIG_LOG_COLORS=y

# FreeRTOS — C6 jest dual-core, nie ustawiamy UNICORE
CONFIG_FREERTOS_USE_TRACE_FACILITY=y
CONFIG_FREERTOS_USE_STATS_FORMATTING_FUNCTIONS=y
```
